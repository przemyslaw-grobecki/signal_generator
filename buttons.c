#include "MKL05Z4.h"                    /* Device header */
#include "buttons.h"
#include "frdm_bsp.h"

/*Number of IRQ generated by PORTA interrupt*/
static const IRQn_Type myPORT_IRQn = PORTA_IRQn;
void Change_Signal(void);
void Change_Mode(void);

#define R1 8																		
#define R2 7                                    
#define R3 6
#define R4 5
#define C4 9
#define C3 10
#define C2 11
#define C1 12

/*----------------------------------------------------------------------------
	Interrupt service routine
	Button will cause PORTA interrupt 
 *----------------------------------------------------------------------------*/

void PORTA_IRQHandler(void){							
	if( PORTA->ISFR & (1 << C2) ){        	/* Check in ISFR register if button BUT1 is pressed */
		Change_Signal();
    while((FPTA->PDIR&(1<<C2))==0);
		DELAY(100)
		PORTA->PCR[C2] |= PORT_PCR_ISF_MASK;
  }
		if( PORTA->ISFR & (1 << C1) ){        	/* Check in ISFR register if button BUT1 is pressed */
		Change_Mode();
    while((FPTA->PDIR&(1<<C1))==0);
		DELAY(100)
		PORTA->PCR[C1] |= PORT_PCR_ISF_MASK;
  }
}

/*----------------------------------------------------------------------------
	Function initializes port C pin for switch 1 (SW1) handling
	and enables PORT_C_D interrupts
 *----------------------------------------------------------------------------*/

void buttonsInitialize(void){
	SIM->SCGC5 |=  SIM_SCGC5_PORTA_MASK; 			
	PORTA->PCR[R4] |= PORT_PCR_MUX(1);      	
	PORTA->PCR[C1] |= PORT_PCR_MUX(1);      	
	PORTA->PCR[C2] |= PORT_PCR_MUX(1);      	     	
																														
	PORTA->PCR[C1] |=  	PORT_PCR_PE_MASK | PORT_PCR_PS_MASK ; 						
	PORTA->PCR[C2] |=  	PORT_PCR_PE_MASK | PORT_PCR_PS_MASK ; 						
																																				
	PORTA->PCR[C1] |= 	PORT_PCR_IRQC(10);																
	PORTA->PCR[C2] |= 	PORT_PCR_IRQC(10);	  														
	
	PTA->PDDR |= (1<<R4);
												
	PTA->PDOR &= ~(1<<R4);
		
	/* ARM's Nested Vector Interrupt Controller configuration */
	NVIC_ClearPendingIRQ(myPORT_IRQn);			
	NVIC_EnableIRQ(myPORT_IRQn);						
	NVIC_SetPriority (myPORT_IRQn, 3);			
}
